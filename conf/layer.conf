## conf/layer.conf
```bitbake
# We have a conf and classes directory, add to BBPATH
BBPATH .= ":${LAYERDIR}"

# Add recipes to to BBFILES
BBFILES += " ${LAYERDIR}/recipes-*/*.bb "
BBFILES += " ${LAYERDIR}/recipes-*/*/*.bb "
BBFILES += " ${LAYERDIR}/recipes-*/*/*.bbappend* "

BBFILE_COLLECTIONS += "x-linux-isp"
BBFILE_PATTERN_x-linux-isp := "^${LAYERDIR}/"
BBFILE_PRIORITY_x-linux-isp = "5"

# This should only be incremented on significant changes that will
# cause compatibility issues with other layers
LAYERVERSION_x-linux-isp = "1"
LAYERSERIES_COMPAT_x-linux-isp = "mickledore"

LAYERDEPENDS_x-linux-isp  = "stm-st-stm32mp"
LAYERDEPENDS_x-linux-isp += "st-openstlinux"

ST_OSTL_COMPATIBILITY_VERSION_x-linux-isp = "5.1"
```
